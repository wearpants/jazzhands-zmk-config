## config/boards/shields/jazzhands/Kconfig.defconfig
```kconfig
# Copyright (c) 2020 The ZMK Contributors
# SPDX-License-Identifier: MIT

if SHIELD_JAZZHANDS_LEFT

config ZMK_KEYBOARD_NAME
	default "Jazzhands"

config ZMK_SPLIT_ROLE_CENTRAL
	default y

config ZMK_COMBO_MAX_COMBOS_PER_KEY
	default 15

endif

if SHIELD_JAZZHANDS_LEFT || SHIELD_JAZZHANDS_RIGHT

config ZMK_SPLIT
	default y

endif
```

## config/boards/shields/jazzhands/Kconfig.shield
```kconfig
# Copyright (c) 2020 The ZMK Contributors
# SPDX-License-Identifier: MIT

config SHIELD_JAZZHANDS_LEFT
	def_bool $(shields_list_contains,jazzhands_left)

config SHIELD_JAZZHANDS_RIGHT
	def_bool $(shields_list_contains,jazzhands_right)
```
